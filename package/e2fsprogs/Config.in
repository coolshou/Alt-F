## package/e2fsprogs/Config.in
```kconfig
config BR2_PACKAGE_E2FSPROGS
	bool "e2fsprogs"
	depends on BR2_LARGEFILE
	select BR2_PACKAGE_LIBUUID
	help
	  The EXT2/3/4 file system utilities and libraries

	  http://e2fsprogs.sourceforge.net/

config BR2_PACKAGE_E2FSPROGS_OPTIM
	string "e2fsprogs optim"
	depends on BR2_PACKAGE_E2FSPROGS
	help
	  Compile optimization options (-Os, -O2)

config BR2_PACKAGE_E2FSPROGS_EXTRA
	bool "extra e2fsprogs utilities"
	default y
	depends on BR2_PACKAGE_E2FSPROGS

comment "e2fsprogs requires a toolchain with LARGEFILE support"
	depends on !BR2_LARGEFILE
```

## package/vsftpd/Config.in
```kconfig
config BR2_PACKAGE_VSFTPD
	bool "vsftpd"
	select BR2_PACKAGE_OPENSSL
	help
	  vsftpd is an ftp daemon written with security in mind.
	  http://vsftpd.beasts.org/

config BR2_PACKAGE_VSFTPD_OPTIM
	string "vsftpd optim"
	depends on BR2_PACKAGE_VSFTPD
	help
	  Compile optimization options (-Os, -O2)
```
